## conf/layer.conf
```bitbake
# We have a conf and classes directory, add to BBPATH
BBPATH .= ":${LAYERDIR}"

# We have recipes-* directories, add to BBFILES
BBFILES += "${LAYERDIR}/recipes-*/*/*.bb \
            ${LAYERDIR}/recipes-*/*/*.bbappend"

BBFILE_COLLECTIONS += "meta-ecu-1270"
BBFILE_PATTERN_meta-ecu-1270 := "^${LAYERDIR}/"
BBFILE_PRIORITY_meta-ecu-1270 = "6"

LAYERDEPENDS_meta-ecu-1270 = "core"
LAYERSERIES_COMPAT_meta-ecu-1270 = "scarthgap"

#PARALLEL_MAKE = "-j 2"
#BB_NUMBER_THREADS = "2"
TOOLCHAIN_TARGET_TASK:append = " kernel-devsrc kernel-modules kernel-dev"
```

## conf/machine/j722s-ecu1270.conf
```bitbake
#@TYPE: Machine
#@NAME: J722S EVM
#@DESCRIPTION: Machine configuration for the TI J722S EVM

require conf/machine/include/j722s.inc

KERNEL_DEVICETREE_PREFIX = " \
    ti/k3-j722s \
    ti/k3-fpdlink \
    ti/k3-v3link \
"

KERNEL_DEVICETREE = "ecu1270"

UBOOT_MACHINE = "j722s_evm_a53_defconfig"

IMAGE_INSTALL:append = " libdrm libdrm-tests"
IMAGE_INSTALL:append = " rauc adv-start "
IMAGE_INSTALL:append = " k3conf " 
IMAGE_BOOT_FILES:append = " k3-j722s-ecu1270.dtb k3-j722s-ecu1270-dio.dtb"
```

## recipes-bsp/u-boot/files/j722s-ecu1270/board/ti/j722s_adv/Kconfig
```kconfig
# SPDX-License-Identifier: GPL-2.0+
#
# Copyright (C) 2024 Texas Instruments Incorporated - https://www.ti.com/
#

if TARGET_J722S_R5_EVM || TARGET_J722S_A53_EVM

config SYS_BOARD
    default "j722s"

config SYS_VENDOR
    default "ti"

config SYS_CONFIG_NAME
    default "j722s_evm"

config BOOT_MMC_DEV_0
    def_bool y

config RECOVERY_KEY
    bool "Config recovery key enable/disable"
    default y
    help
      This config recovery key enable/disable.

config RECOVERY_KEY_GPIO
    int "Config recovery key gpio pin value"
    depends on RECOVERY_KEY
    default 3
    help
      This config recovery key gpio pin value.

config RECOVERY_KEY_DELAY
    int "Config recovery key press delay time, defaule 5 second"
    depends on RECOVERY_KEY
    default 2
    help
      This config recovery key press delay time, default 5 second.

source "board/ti/common/Kconfig"

endif

if TARGET_J722S_R5_EVM

config SPL_LDSCRIPT
    default "arch/arm/mach-omap2/u-boot-spl.lds"

endif
```
